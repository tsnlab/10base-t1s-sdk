/dts-v1/;
/plugin/;

/ {
    compatible = "brcm,bcm2711";

    fragment@0 {
        target = <&spi0>;
        __overlay__ {
            #address-cells = <1>;
            #size-cells = <0>;
            status = "okay";

            lan8650: ethernet@0 {
                compatible = "microchip,lan8651", "microchip,lan8650";
                reg = <0>;  /* CE0 */
                interrupt-parent = <&gpio>;
                interrupts = <23 2>; /* IRQ_TYPE_EDGE_FALLING */
                reset-gpios = <&gpio 22 0>; /* GPIO_ACTIVE_LOW */
                #status = "okay";
                #spi-cpol;
                #spi-cpha;
            };
        };
    };
};
