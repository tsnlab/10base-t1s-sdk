/dts-v1/;
/plugin/;

/ {
    compatible = "brcm,bcm2711";

    fragment@0 {
        target = <&spi0>;
        __overlay__ {
            #address-cells = <1>;
            #size-cells = <0>;
            status = "okay";

            lan8650: ethernet@0 {
                compatible = "microchip,lan8651", "microchip,lan8650";
                reg = <0>;  /* CE0 */
                interrupt-parent = <&gpio>;
            
                interrupts = <23 2 /* IRQ_TYPE_EDGE_FALLING */>;        /* GPIO23 - LAN8651_SPI_IRQ */
                fxl6408irq-gpios = <&gpio 24 1 /* GPIO_ACTIVE_LOW */>;  /* GPIO24 - FXL6408_I2C_IRQ */
            };
        };
    };
};